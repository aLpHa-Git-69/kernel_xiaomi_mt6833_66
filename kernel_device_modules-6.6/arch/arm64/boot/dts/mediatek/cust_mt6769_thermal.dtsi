// SPDX-License-Identifier: GPL-2.0
/* Copyright (c) 2023 MediaTek Inc. */

&soc {

	//#ifdef CAMELLIA_FEATURE_POWER_THERMAL
	shell_front {
		compatible = "camellia,shell-temp";
	};

	shell_frame {
		compatible = "camellia,shell-temp";
	};

	shell_back {
		compatible = "camellia,shell-temp";
	};
//#endif /* CAMELLIA_FEATURE_POWER_THERMAL */
};

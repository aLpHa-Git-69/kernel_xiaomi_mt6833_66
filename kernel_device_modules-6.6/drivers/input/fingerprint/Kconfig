## kernel_device_modules-6.6/drivers/power/Kconfig
```kconfig
# SPDX-License-Identifier: GPL-2.0-only
#source "drivers/power/reset/Kconfig"
#source "drivers/power/supply/Kconfig"
#ifdef OPLUS_FEATURE_CHG_BASIC

config OPLUS_PD_EXT_SUPPORT
	bool "TypeC Port Controller Extern"
	default n
	help
	  Say Y to enable

#endif
```
